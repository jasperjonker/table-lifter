## app/boards/jasper/table_lifter/Kconfig.table_lifter
```kconfig
config BOARD_TABLE_LIFTER
  select SOC_NRF54L15_CPUAPP if BOARD_TABLE_LIFTER_NRF54L15_CPUAPP
```

## app/boards/jasper/table_lifter/board.yml
```yaml
board:
  name: table_lifter
  full_name: Table Lifter nRF54L15
  vendor: jasper
  socs:
    - name: nrf54l15
```
